// SPDX-License-Identifier: BSD-3-Clause
/*
 * Xiaomi Pad 5 (nabu) production derivative with Iris/Venus, camera,
 * SLPI/SSC accelerometer and battery/charging enabled.
 *
 * This is the combination DTS used by the production UKI. It must be built
 * after the nabu-iris, nabu-camera and nabu-accelerometer overlays have been
 * installed, because it includes their .dtsi fragments. It uses the final
 * SLPI/SSC accelerometer fragment, not the retired AP-side LSM6DSO path.
 */

#include "sm8150-xiaomi-nabu.dts"
#include "sm8150-xiaomi-nabu-iris.dtsi"
#include "sm8150-xiaomi-nabu-camera.dtsi"
#include "sm8150-xiaomi-nabu-accelerometer-slpi-boot-only.dtsi"
#include "sm8150-xiaomi-nabu-power.dtsi"
